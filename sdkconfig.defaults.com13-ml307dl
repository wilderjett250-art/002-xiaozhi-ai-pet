## sdkconfig.defaults.com13-ml307dl
```kconfig
CONFIG_BOARD_TYPE_BREAD_COMPACT_ML307=y
CONFIG_OLED_SSD1306_128X32=y
CONFIG_COMPANION_CLOUD_DEVICE_NAME="Xiaozhi 4G COM13"
```

## sdkconfig.defaults.s3-ml307dl-second
```kconfig
CONFIG_BOARD_TYPE_BREAD_COMPACT_WIFI_CAM=y
CONFIG_LCD_ST7789_240X320=y
CONFIG_ESPTOOLPY_FLASHMODE_DIO=y
CONFIG_PARTITION_TABLE_CUSTOM=y
CONFIG_PARTITION_TABLE_CUSTOM_FILENAME="partitions/v2/16m_cat_pet.csv"
CONFIG_USE_CUSTOM_WAKE_WORD=y
CONFIG_CUSTOM_WAKE_WORD="hai miao miao,xiao miao xiao miao,ni hao xiao zhi"
CONFIG_CUSTOM_WAKE_WORD_DISPLAY="嗨喵喵,小喵小喵,你好小智"
CONFIG_CUSTOM_WAKE_WORD_THRESHOLD=20
CONFIG_SR_WN_WN9_NIHAOXIAOZHI_TTS=n
CONFIG_SR_MN_CN_MULTINET5_RECOGNITION_QUANT8=y
CONFIG_COMPANION_CLOUD_DEVICE_NAME="Cat Desktop Pet 2"
```
